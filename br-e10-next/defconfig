## br-e10-next/defconfig
```kconfig
BR2_arm=y
BR2_arm926t=y
BR2_JLEVEL=4
BR2_OPTIMIZE_2=y
BR2_BINUTILS_VERSION_2_23_1=y
BR2_GCC_VERSION_4_7_X=y
BR2_ENABLE_LOCALE_PURGE=y
BR2_ENABLE_LOCALE_WHITELIST="C en_US"
BR2_TOOLCHAIN_BUILDROOT_LARGEFILE=y
BR2_TOOLCHAIN_BUILDROOT_INET_IPV6=y
BR2_TOOLCHAIN_BUILDROOT_INET_RPC=y
BR2_TOOLCHAIN_BUILDROOT_LOCALE=y
BR2_TARGET_GENERIC_HOSTNAME="e10-nextc8b1"
BR2_TARGET_GENERIC_ISSUE="E10 Next build 20121123"
BR2_ROOTFS_DEVICE_CREATION_DYNAMIC_UDEV=y
BR2_ROOTFS_DEVICE_TABLE="target/generic/device_table.txt"
BR2_ROOTFS_POST_BUILD_SCRIPT="./board/synapse/e10/post-build.sh"
BR2_PACKAGE_BUSYBOX_CONFIG="board/synapse/e10/busybox-1.20.x.config"
BR2_PACKAGE_BUSYBOX_SHOW_OTHERS=y
BR2_PACKAGE_DSTAT=y
BR2_PACKAGE_GMP=y
BR2_PACKAGE_CIFS_UTILS=y
BR2_PACKAGE_MTD=y
BR2_PACKAGE_GPIO9260=y
BR2_PACKAGE_IOSTAT=y
BR2_PACKAGE_LINUX_FIRMWARE=y
BR2_PACKAGE_LINUX_FIRMWARE_ATHEROS_7010=y
BR2_PACKAGE_LINUX_FIRMWARE_ATHEROS_9271=y
BR2_PACKAGE_LINUX_FIRMWARE_RALINK_RT61=y
BR2_PACKAGE_LINUX_FIRMWARE_RALINK_RT73=y
BR2_PACKAGE_LINUX_FIRMWARE_RALINK_RT2XX=y
BR2_PACKAGE_LINUX_FIRMWARE_RTL_8192=y
BR2_PACKAGE_LINUX_FIRMWARE_RTL_8712=y
BR2_PACKAGE_LINUX_FIRMWARE_TI_WL127X=y
BR2_PACKAGE_LINUX_FIRMWARE_TI_WL128X=y
BR2_PACKAGE_NANOCOM=y
BR2_PACKAGE_OFONO=y
BR2_PACKAGE_OPEN2300=y
BR2_PACKAGE_SETSERIAL=y
BR2_PACKAGE_STATSERIAL=y
BR2_PACKAGE_SYSSTAT=y
BR2_PACKAGE_UBOOT_TOOLS=y
BR2_PACKAGE_UBOOT_TOOLS_MKIMAGE=y
BR2_PACKAGE_UDEV_ALL_EXTRAS=y
BR2_PACKAGE_USB_MODESWITCH_DATA=y
BR2_PACKAGE_USBMOUNT=y
BR2_PACKAGE_USBUTILS=y
BR2_PACKAGE_USBUTILS_ZLIB=y
BR2_PACKAGE_PYTHON_BZIP2=y
BR2_PACKAGE_PYTHON_BSDDB=y
BR2_PACKAGE_PYTHON_CURSES=y
BR2_PACKAGE_PYTHON_PYEXPAT=y
BR2_PACKAGE_PYTHON_READLINE=y
BR2_PACKAGE_PYTHON_SSL=y
BR2_PACKAGE_PYTHON_SQLITE=y
BR2_PACKAGE_PYTHON_NETIFACES=y
BR2_PACKAGE_PYTHON_SERIAL=y
BR2_PACKAGE_RUBY=y
# BR2_PACKAGE_TCL_SHLIB_ONLY is not set
BR2_PACKAGE_LZO=y
BR2_PACKAGE_OPENSSL_BIN=y
BR2_PACKAGE_SQLITE_READLINE=y
BR2_PACKAGE_LIBDAEMON=y
BR2_PACKAGE_LIBXML2=y
BR2_PACKAGE_COLLECTD=y
BR2_PACKAGE_COLLECTD_EMPTY_COUNTER=y
BR2_PACKAGE_COLLECTD_TIMEDIFF=y
BR2_PACKAGE_COLLECTD_VALUE=y
BR2_PACKAGE_THRESHOLD=y
BR2_PACKAGE_COLLECTD_CONNTRACK=y
BR2_PACKAGE_COLLECTD_CONTEXTSWITCH=y
BR2_PACKAGE_COLLECTD_CPU=y
BR2_PACKAGE_COLLECTD_CPUFREQ=y
BR2_PACKAGE_COLLECTD_DF=y
BR2_PACKAGE_COLLECTD_INTERFACE=y
BR2_PACKAGE_COLLECTD_LOAD=y
BR2_PACKAGE_COLLECTD_MEMORY=y
BR2_PACKAGE_COLLECTD_NTPD=y
BR2_PACKAGE_COLLECTD_PING=y
BR2_PACKAGE_COLLECTD_PROCESSES=y
BR2_PACKAGE_COLLECTD_SNMP=y
BR2_PACKAGE_COLLECTD_UPTIME=y
BR2_PACKAGE_COLLECTD_USERS=y
BR2_PACKAGE_COLLECTD_WIRELESS=y
BR2_PACKAGE_COLLECTD_NOTIFICATION=y
BR2_PACKAGE_COLLECTD_CSV=y
BR2_PACKAGE_COLLECTD_RRDTOOL=y
BR2_PACKAGE_CUPS=y
BR2_PACKAGE_ETHTOOL=y
BR2_PACKAGE_HEIRLOOM_MAILX=y
BR2_PACKAGE_IPROUTE2=y
BR2_PACKAGE_IPTABLES=y
BR2_PACKAGE_IW=y
BR2_PACKAGE_LIGHTTPD=y
BR2_PACKAGE_LIGHTTPD_OPENSSL=y
BR2_PACKAGE_LIGHTTPD_ZLIB=y
BR2_PACKAGE_LIGHTTPD_BZIP2=y
BR2_PACKAGE_LINKS=y
BR2_PACKAGE_LRZSZ=y
BR2_PACKAGE_NCFTP=y
BR2_PACKAGE_NOIP=y
BR2_PACKAGE_NTP=y
BR2_PACKAGE_NTP_SNTP=y
BR2_PACKAGE_NTP_NTPDATE=y
BR2_PACKAGE_OPENSSH=y
BR2_PACKAGE_PORTMAP=y
BR2_PACKAGE_PPPD=y
BR2_PACKAGE_PPTP_LINUX=y
BR2_PACKAGE_RSYNC=y
BR2_PACKAGE_WIRELESS_TOOLS=y
BR2_PACKAGE_WPA_SUPPLICANT=y
BR2_PACKAGE_WPA_SUPPLICANT_EAP=y
BR2_PACKAGE_WPA_SUPPLICANT_CLI=y
BR2_PACKAGE_WPA_SUPPLICANT_PASSPHRASE=y
BR2_PACKAGE_WPA_SUPPLICANT_WPS=y
BR2_PACKAGE_OPKG=y
BR2_PACKAGE_BASH=y
BR2_PACKAGE_DIALOG=y
BR2_PACKAGE_FILE=y
BR2_PACKAGE_LOGROTATE=y
BR2_PACKAGE_SCREEN=y
BR2_PACKAGE_BWM_NG=y
BR2_PACKAGE_HTOP=y
BR2_PACKAGE_MONIT=y
BR2_PACKAGE_SYSTEMD=y
BR2_PACKAGE_NANO=y
# BR2_PACKAGE_NANO_TINY is not set
BR2_TARGET_ROOTFS_JFFS2=y
BR2_TARGET_ROOTFS_JFFS2_NANDFLASH_2K_128K=y
BR2_TARGET_ROOTFS_JFFS2_PAD=y
BR2_TARGET_ROOTFS_JFFS2_SUMMARY=y
BR2_TARGET_ROOTFS_UBIFS=y
BR2_TARGET_ROOTFS_UBI=y
BR2_TARGET_UBOOT=y
BR2_TARGET_UBOOT_BOARDNAME="e10"
BR2_TARGET_UBOOT_2011_12=y
BR2_TARGET_UBOOT_CUSTOM_PATCH_DIR="board/synapse/e10/uboot/"
BR2_LINUX_KERNEL=y
BR2_LINUX_KERNEL_PATCH="board/synapse/e10/linux-3.6.3-patches/*"
BR2_LINUX_KERNEL_USE_CUSTOM_CONFIG=y
BR2_LINUX_KERNEL_CUSTOM_CONFIG_FILE="board/synapse/e10/linux-3.4.2-config"
```

## br-e10-recv/defconfig
```kconfig
BR2_arm=y
BR2_arm926t=y
BR2_JLEVEL=4
BR2_OPTIMIZE_2=y
BR2_KERNEL_HEADERS_3_3=y
BR2_BINUTILS_VERSION_2_23=y
BR2_GCC_VERSION_4_7_X=y
BR2_TOOLCHAIN_BUILDROOT_LARGEFILE=y
BR2_TOOLCHAIN_BUILDROOT_INET_RPC=y
BR2_TARGET_GENERIC_HOSTNAME="e10-recovery"
BR2_TARGET_GENERIC_ISSUE="E10 Recovery Image 20121110"
BR2_ROOTFS_POST_BUILD_SCRIPT="board/synapse/e10/post-build.sh"
BR2_PACKAGE_BUSYBOX_CONFIG="package/busybox/busybox-1.19.x.config"
BR2_PACKAGE_BUSYBOX_SHOW_OTHERS=y
BR2_PACKAGE_BZIP2=y
BR2_PACKAGE_MTD=y
BR2_PACKAGE_UBOOT_TOOLS=y
BR2_PACKAGE_UBOOT_TOOLS_MKIMAGE=y
BR2_PACKAGE_DROPBEAR=y
BR2_PACKAGE_DROPBEAR_DISABLE_REVERSEDNS=y
BR2_PACKAGE_LRZSZ=y
BR2_PACKAGE_NCFTP=y
BR2_PACKAGE_PORTMAP=y
BR2_PACKAGE_BASH=y
BR2_PACKAGE_DIALOG=y
BR2_PACKAGE_LOCKFILE_PROGS=y
BR2_PACKAGE_NANO=y
BR2_TARGET_ROOTFS_INITRAMFS=y
BR2_LINUX_KERNEL=y
BR2_LINUX_KERNEL_SAME_AS_HEADERS=y
BR2_LINUX_KERNEL_PATCH="board/synapse/e10/linux-3.3.2-patches/*"
BR2_LINUX_KERNEL_USE_CUSTOM_CONFIG=y
BR2_LINUX_KERNEL_CUSTOM_CONFIG_FILE="board/synapse/e10/linux-3.3.7-recv-config"
```

## br1305-main/configs/e10_defconfig
```kconfig
BR2_arm=y
BR2_JLEVEL=4
BR2_OPTIMIZE_2=y
BR2_KERNEL_HEADERS_VERSION=y
BR2_DEFAULT_KERNEL_VERSION="3.3.8"
BR2_BINUTILS_VERSION_2_23_2=y
BR2_ENABLE_LOCALE_PURGE=y
BR2_ENABLE_LOCALE_WHITELIST="C en_US"
BR2_TOOLCHAIN_BUILDROOT_LARGEFILE=y
BR2_TOOLCHAIN_BUILDROOT_INET_RPC=y
BR2_TOOLCHAIN_BUILDROOT_LOCALE=y
BR2_TOOLCHAIN_BUILDROOT_CXX=y
BR2_TOOLCHAIN_BUILDROOT_USE_SSP=y
BR2_TARGET_GENERIC_HOSTNAME="e10-1305c0b0"
BR2_TARGET_GENERIC_ISSUE="E10 BR1305 20130713"
BR2_ROOTFS_DEVICE_CREATION_DYNAMIC_UDEV=y
BR2_ROOTFS_POST_BUILD_SCRIPT="./board/synapse/e10/post-build.sh"
BR2_PACKAGE_MTD=y
BR2_PACKAGE_DBUS=y
BR2_PACKAGE_INPUT_EVENT_DAEMON=y
BR2_PACKAGE_IOSTAT=y
BR2_PACKAGE_PICOCOM=y
BR2_PACKAGE_SETSERIAL=y
BR2_PACKAGE_STATSERIAL=y
BR2_PACKAGE_SYSSTAT=y
BR2_PACKAGE_USB_MODESWITCH=y
BR2_PACKAGE_USBMOUNT=y
BR2_PACKAGE_USBUTILS=y
BR2_PACKAGE_USBUTILS_ZLIB=y
BR2_PACKAGE_PYTHON=y
BR2_PACKAGE_PYTHON_BZIP2=y
BR2_PACKAGE_PYTHON_BSDDB=y
BR2_PACKAGE_PYTHON_CURSES=y
BR2_PACKAGE_PYTHON_READLINE=y
BR2_PACKAGE_PYTHON_SSL=y
BR2_PACKAGE_PYTHON_SQLITE=y
BR2_PACKAGE_PYTHON_HASHLIB=y
BR2_PACKAGE_PYTHON_BOTTLE=y
BR2_PACKAGE_PYTHON_DPKT=y
BR2_PACKAGE_PYTHON_MELD3=y
BR2_PACKAGE_PYTHON_NETIFACES=y
BR2_PACKAGE_PYTHON_PROTOBUF=y
BR2_PACKAGE_PYTHON_SERIAL=y
BR2_PACKAGE_PYTHON_THRIFT=y
BR2_PACKAGE_LZO=y
BR2_PACKAGE_LIBDAEMON=y
BR2_PACKAGE_CUPS=y
BR2_PACKAGE_ETHTOOL=y
BR2_PACKAGE_IPERF=y
BR2_PACKAGE_IPROUTE2=y
BR2_PACKAGE_IPTABLES=y
BR2_PACKAGE_IW=y
BR2_PACKAGE_LRZSZ=y
BR2_PACKAGE_NCFTP=y
BR2_PACKAGE_NTP=y
BR2_PACKAGE_NTP_SNTP=y
BR2_PACKAGE_NTP_NTPDATE=y
BR2_PACKAGE_OPENSSH=y
BR2_PACKAGE_PORTMAP=y
BR2_PACKAGE_PPPD=y
BR2_PACKAGE_RSYNC=y
BR2_PACKAGE_WIRELESS_TOOLS=y
BR2_PACKAGE_WPA_SUPPLICANT=y
BR2_PACKAGE_WPA_SUPPLICANT_EAP=y
BR2_PACKAGE_WPA_SUPPLICANT_CLI=y
BR2_PACKAGE_WPA_SUPPLICANT_PASSPHRASE=y
BR2_PACKAGE_IPKG=y
BR2_PACKAGE_DIALOG=y
BR2_PACKAGE_SCREEN=y
BR2_PACKAGE_BWM_NG=y
BR2_PACKAGE_HTOP=y
BR2_PACKAGE_NANO=y
BR2_TARGET_ROOTFS_JFFS2=y
BR2_TARGET_ROOTFS_JFFS2_NANDFLASH_2K_128K=y
BR2_TARGET_ROOTFS_JFFS2_PAD=y
BR2_TARGET_ROOTFS_JFFS2_SUMMARY=y
BR2_LINUX_KERNEL=y
BR2_LINUX_KERNEL_SAME_AS_HEADERS=y
BR2_LINUX_KERNEL_PATCH="board/synapse/e10/linux-3.3.2-patches/"
BR2_LINUX_KERNEL_USE_CUSTOM_CONFIG=y
BR2_LINUX_KERNEL_CUSTOM_CONFIG_FILE="board/synapse/e10/linux-3.3.6-config"
```

## br1305-main/configs/e10web_defconfig
```kconfig
BR2_arm=y
BR2_arm926t=y
BR2_JLEVEL=4
BR2_OPTIMIZE_2=y
BR2_KERNEL_HEADERS_3_3=y
BR2_BINUTILS_VERSION_2_22=y
BR2_GCC_VERSION_4_7_X=y
BR2_GCC_ENABLE_OPENMP=y
BR2_ENABLE_LOCALE_PURGE=y
BR2_ENABLE_LOCALE_WHITELIST="C en_US"
BR2_TOOLCHAIN_BUILDROOT_LARGEFILE=y
BR2_TOOLCHAIN_BUILDROOT_INET_IPV6=y
BR2_TOOLCHAIN_BUILDROOT_INET_RPC=y
BR2_TOOLCHAIN_BUILDROOT_LOCALE=y
BR2_TOOLCHAIN_BUILDROOT_CXX=y
BR2_TOOLCHAIN_BUILDROOT_USE_SSP=y
BR2_TARGET_GENERIC_HOSTNAME="e10-nextc6b3-web"
BR2_TARGET_GENERIC_ISSUE="E10 Next build 20120601 web"
BR2_ROOTFS_DEVICE_CREATION_DYNAMIC_UDEV=y
BR2_ROOTFS_POST_BUILD_SCRIPT="./board/synapse/e10/post-build.sh"
BR2_PACKAGE_BUSYBOX_CONFIG="board/synapse/e10/busybox-1.20.x.config"
BR2_PACKAGE_DSTAT=y
BR2_PACKAGE_GMP=y
BR2_PACKAGE_RRDTOOL=y
BR2_PACKAGE_GPIO9260=y
BR2_PACKAGE_DBUS=y
BR2_PACKAGE_IOSTAT=y
BR2_PACKAGE_LINUX_FIRMWARE=y
BR2_PACKAGE_LINUX_FIRMWARE_ATHEROS_7010=y
BR2_PACKAGE_LINUX_FIRMWARE_ATHEROS_9271=y
BR2_PACKAGE_LINUX_FIRMWARE_RALINK_RT61=y
BR2_PACKAGE_LINUX_FIRMWARE_RALINK_RT73=y
BR2_PACKAGE_LINUX_FIRMWARE_RALINK_RT2XX=y
BR2_PACKAGE_LINUX_FIRMWARE_TI_WL127X=y
BR2_PACKAGE_LINUX_FIRMWARE_TI_WL128X=y
BR2_PACKAGE_MTD=y
BR2_PACKAGE_PICOCOM=y
BR2_PACKAGE_SETSERIAL=y
BR2_PACKAGE_STATSERIAL=y
BR2_PACKAGE_SYSSTAT=y
BR2_PACKAGE_UBOOT_TOOLS=y
BR2_PACKAGE_UBOOT_TOOLS_MKIMAGE=y
BR2_PACKAGE_USB_MODESWITCH=y
BR2_PACKAGE_USB_MODESWITCH_DATA=y
BR2_PACKAGE_USBMOUNT=y
BR2_PACKAGE_USBUTILS=y
BR2_PACKAGE_USBUTILS_ZLIB=y
BR2_PACKAGE_PYTHON_BZIP2=y
BR2_PACKAGE_PYTHON_BSDDB=y
BR2_PACKAGE_PYTHON_CURSES=y
BR2_PACKAGE_PYTHON_PYEXPAT=y
BR2_PACKAGE_PYTHON_READLINE=y
BR2_PACKAGE_PYTHON_SSL=y
BR2_PACKAGE_PYTHON_SQLITE=y
BR2_PACKAGE_PYTHON_NETIFACES=y
BR2_PACKAGE_PYTHON_SERIAL=y
BR2_PACKAGE_RUBY=y
BR2_PACKAGE_TCL=y
# BR2_PACKAGE_TCL_SHLIB_ONLY is not set
BR2_PACKAGE_LZO=y
BR2_PACKAGE_OPENSSL_BIN=y
BR2_PACKAGE_MYSQL_CLIENT=y
BR2_PACKAGE_SQLITE_READLINE=y
BR2_PACKAGE_LIBFTDI=y
BR2_PACKAGE_LIBTFDI_CPP=y
BR2_PACKAGE_LIBDAEMON=y
BR2_PACKAGE_LIBXML2=y
BR2_PACKAGE_BWM_NG=y
BR2_PACKAGE_CIFS_UTILS=y
BR2_PACKAGE_CUPS=y
BR2_PACKAGE_ETHTOOL=y
BR2_PACKAGE_HEIRLOOM_MAILX=y
BR2_PACKAGE_IPERF=y
BR2_PACKAGE_IPROUTE2=y
BR2_PACKAGE_IPTABLES=y
BR2_PACKAGE_IW=y
BR2_PACKAGE_LINKS=y
BR2_PACKAGE_LRZSZ=y
BR2_PACKAGE_NCFTP=y
BR2_PACKAGE_NOIP=y
BR2_PACKAGE_NTP=y
BR2_PACKAGE_NTP_SNTP=y
BR2_PACKAGE_NTP_NTPDATE=y
BR2_PACKAGE_OPENSSH=y
BR2_PACKAGE_PORTMAP=y
BR2_PACKAGE_PPPD=y
BR2_PACKAGE_PPTP_LINUX=y
BR2_PACKAGE_RSYNC=y
BR2_PACKAGE_WIRELESS_TOOLS=y
BR2_PACKAGE_WPA_SUPPLICANT=y
BR2_PACKAGE_WPA_SUPPLICANT_EAP=y
BR2_PACKAGE_WPA_SUPPLICANT_CLI=y
BR2_PACKAGE_WPA_SUPPLICANT_PASSPHRASE=y
BR2_PACKAGE_OPKG=y
BR2_PACKAGE_DIALOG=y
BR2_PACKAGE_FILE=y
BR2_PACKAGE_LOGROTATE=y
BR2_PACKAGE_SCREEN=y
BR2_PACKAGE_HTOP=y
BR2_PACKAGE_NANO=y
# BR2_PACKAGE_NANO_TINY is not set
BR2_TARGET_ROOTFS_JFFS2=y
BR2_TARGET_ROOTFS_JFFS2_NANDFLASH_2K_128K=y
BR2_TARGET_ROOTFS_JFFS2_PAD=y
BR2_TARGET_ROOTFS_JFFS2_SUMMARY=y
BR2_TARGET_ROOTFS_UBIFS=y
BR2_TARGET_ROOTFS_UBI=y
BR2_TARGET_UBOOT=y
BR2_TARGET_UBOOT_BOARDNAME="e10"
BR2_TARGET_UBOOT_2011_12=y
BR2_TARGET_UBOOT_CUSTOM_PATCH_DIR="board/synapse/e10/uboot/"
BR2_LINUX_KERNEL=y
BR2_LINUX_KERNEL_SAME_AS_HEADERS=y
BR2_LINUX_KERNEL_PATCH="board/synapse/e10/linux-3.3.2-patches/*"
BR2_LINUX_KERNEL_USE_CUSTOM_CONFIG=y
BR2_LINUX_KERNEL_CUSTOM_CONFIG_FILE="board/synapse/e10/linux-3.3.6-config"
```
